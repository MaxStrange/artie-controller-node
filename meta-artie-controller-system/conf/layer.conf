## meta-artie-controller-system/conf/layer.conf
```bitbake
# Based on https://github.com/jumpnow/meta-rpi under MIT

# We have a conf and classes directory, append to BBPATH
BBPATH .= ":${LAYERDIR}"

# Here's where we would add recipes and append files for this layer
#BBFILES += "${LAYERDIR}/recipes*/*/*.bb ${LAYERDIR}/recipes*/*/*.bbappend ${LAYERDIR}/images/*.bb"

BBFILE_COLLECTIONS += "meta-artie-controller-system"
BBFILE_PATTERN:meta-artie-controller-system := "^${LAYERDIR}/"
BBFILE_PRIORITY:meta-artie-controller-system = "16"

LAYERSERIES_COMPAT:meta-artie-controller-system = "kirkstone"
```

## meta-controller-node/conf/layer.conf
```bitbake
# We have a conf and classes directory, add to BBPATH
BBPATH .= ":${LAYERDIR}"

# We have recipes-* directories, add to BBFILES
BBFILES += "${LAYERDIR}/recipes-*/*/*.bb \
            ${LAYERDIR}/recipes-*/*/*.bbappend"

BBFILE_COLLECTIONS += "meta-controller-node-system"
BBFILE_PATTERN_meta-controller-node-system = "^${LAYERDIR}/"
BBFILE_PRIORITY_meta-controller-node-system = "6"

LAYERDEPENDS_meta-controller-node-system = "core"
LAYERSERIES_COMPAT_meta-controller-node-system = "kirkstone"
```
